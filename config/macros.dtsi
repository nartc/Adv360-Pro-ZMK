macro_nexttab: macro_nexttab{
compatible = "zmk,behavior-macro";
label = "macro_nexttab";
#binding-cells = <0>;
bindings = <&kp LEFT_COMMAND>, <&kp LEFT_SHIFT>, <&kp RIGHT_BRACKET>;
};
macro_prevtab: macro_prevtab{
compatible = "zmk,behavior-macro";
label = "macro_prevtab";
#binding-cells = <0>;
bindings = <&kp LEFT_COMMAND>, <&kp LEFT_SHIFT>, <&kp LEFT_BRACKET>;
};
macro_arrowfn: macro_arrowfn{
compatible = "zmk,behavior-macro";
label = "macro_arrowfn";
#binding-cells = <0>;
bindings = <&kp EQUAL>, <&kp GREATER_THAN>;
};
macro_kinesis: macro_kinesis{
compatible = "zmk,behavior-macro";
label = "macro_kinesis";
#binding-cells = <0>;
bindings = <&kp LS(K)>, <&kp I>, <&kp N>, <&kp E>, <&kp S>, <&kp I>, <&kp S>;
};